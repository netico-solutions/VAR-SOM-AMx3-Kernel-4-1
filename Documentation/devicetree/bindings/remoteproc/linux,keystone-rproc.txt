## Documentation/devicetree/bindings/remoteproc/linux,keystone-rproc.txt
```
Keystone Remoteproc driver

This file provides information about, what the device tree entry for the
remoteproc accessible remote processor should contain for keystone devices.

Required properties:
- compatible : 	"ti,keystone-rproc"
- reg :			Register start address and the size that will be
			used by the driver correspond to register names
			under reg-names

- reg-names = 		Should contain strings with the following names,
			each representing a specific register.
			"boot-address", "psc-mdstat", "psc-mdctl","ipcgr";

- mem : 		Memory start address and size of the local memory
			region of the remote processor used by the driver

- interrupt-parent,
  interrupts 	: 	Standard interrupt property for two interrupts
			generated from the remote processor to the host
			processor.
			First entry:
			Interrupt for vring  from remote processor
			Second entry: (optional)
			Interrupt for exception from remote processor

- kick-gpio: 		Used to specify gpio device assocated with the
			remote processor for the kick operation from Host
			to the remote processor and should be defined as
			per the bindings in
			Documentation/devicetree/bindings/gpio/gpio.txt

- clocks : 		desired clock domain property and should be defined
			as per the bindings in
			Documentation/devicetree/bindings/clock/keystone-gate.txt

Optional properties:

- memory-region:phandle to the reserved memory node to be associated
			with the remoteproc device. The reserved memory node
			should be a CMA memory node, and should be defined as
			per the bindings in
			Documentation/devicetree/bindings/reserved-memory/reserved-memory.txt

Example:

/* K2HK DSP node in SoC DTS file */
soc {
		dsp0: dsp0 {
			compatible = "ti,keystone-rproc";
			reg = <0x02620040 4
			       0x0235083c 4
			       0x02350a3c 4
			       0x02620240 4>;
			reg-names = "boot-address", "psc-mdstat", "psc-mdctl",
				"ipcgr";
			mem = <0x10e00000 0x00008000
			       0x10f00000 0x00008000
			       0x10800000 0x00100000>;
			interrupt-parent = <&kirq0>;
			interrupts = <8 0>;
			kick-gpio = <&dspgpio0 27 0>;
			clocks = <&clkgem0>;
			status = "disabled";
		};
}


&dsp0 {
	status = "okay";
	memory-region = <&dsp_common_cma_pool>;
};
```
